#include <LoRa.h> //Biblioteca para conexão LoRa
#include <SPI.h>
#include <Wire.h>

#include <Adafruit_GFX.h> //Gerenciamento do display
#include <Adafruit_SSD1306.h> //Conexão com o display
#include "Adafruit_VL53L0X.h" // Biblioteca do sensor

Adafruit_VL53L0X lox = Adafruit_VL53L0X(); // Utilizando a biblioteca do sensor

/* Definicoes para comunicação com radio LoRa */
#define SCK_LORA 5
#define MISO_LORA 19
#define MOSI_LORA 27
#define RESET_PIN_LORA 14
#define SS_PIN_LORA 18

#define HIGH_GAIN_LORA 20 /* dBm */
#define BAND 915E6        /* 915MHz de frequencia */

/* Definicoes do OLED */
#define OLED_SDA_PIN 4
#define OLED_SCL_PIN 15
#define SCREEN_WIDTH 128
#define SCREEN_HEIGHT 64
#define OLED_ADDR 0x3C
#define OLED_RESET 16

/* Offset de linhas no display OLED */
#define OLED_LINE1 0
#define OLED_LINE2 10
#define OLED_LINE3 20
#define OLED_LINE4 30
#define OLED_LINE5 40
#define OLED_LINE6 50

/* Definicoes gerais */
#define DEBUG_SERIAL_BAUDRATE 115200

/* Variaveis globais */
char *id_sensor = "1";     // ID do Sensor, precisa ser mapeado dentro do código do Server
int tamanho_tanque = 250; // Tamanho total do tanque a ser analisado
double info = 0;             // Informação a ser enviada ao servidor (Sempre em números inteiros)

static const uint8_t scania_logo[1952] = {
    0xff, 0xff, 0xff, 0xff, 0xff, 0xff, 0xff, 0xff, 0xff, 0xff, 0xff, 0xff, 0xff, 0xff, 0xff, 0xc0, 
    0xff, 0xff, 0xff, 0xff, 0xff, 0xff, 0xff, 0xff, 0xff, 0xff, 0xff, 0xff, 0xff, 0xff, 0xff, 0xc0, 
    0xff, 0xff, 0xff, 0xff, 0xff, 0xff, 0xff, 0xff, 0xff, 0xff, 0xff, 0xff, 0xff, 0xff, 0xff, 0xc0, 
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    0xff, 0xff, 0xff, 0xff, 0xff, 0xff, 0xff, 0xff, 0xff, 0xff, 0xff, 0xff, 0xff, 0xff, 0xff, 0xc0
};


Adafruit_SSD1306 display(SCREEN_WIDTH, SCREEN_HEIGHT, &Wire, OLED_RESET); // Controle da Tela do Módulo

/* Declaração de funções */
bool loRaInit(void);
/*
 * Funcao: inicia comunicação com chip LoRa
 * Parametros: nenhum
 * Retorno: true: comunicacao ok
 *          false: falha na comunicacao
 */

bool displayInit(void);
/*
Funcao: inicia a comunicacao com chip LoRa
Parametros: nenhum
Retorno: true: comunicação ok
         false: falha na comunicacao
*/

bool loRaInit(void)
{
    bool status_init = false;

    Serial.println("[LoRa Sender] Tentando iniciar comunicacao com o radio LoRa...");
    SPI.begin(SCK_LORA, MISO_LORA, MOSI_LORA, SS_PIN_LORA);
    LoRa.setPins(SS_PIN_LORA, RESET_PIN_LORA, LORA_DEFAULT_DIO0_PIN);

    if (!LoRa.begin(BAND))
    {
        Serial.println("[LoRa Sender] Comunicacao com o radio LoRa falhou. Nova tentativa em 1 segundo...");
        delay(1000);
        status_init = false;
    }
    else
    {
        /* Configura o ganho do receptor LoRa para 20dBm, o maior ganho possível (visando maior alcance possível) */
        LoRa.setTxPower(HIGH_GAIN_LORA);
        Serial.println("[LoRa Sender] Comunicacao com o radio LoRa ok");
        status_init = true;
    }

    return status_init;
}

bool displayInit(void)
{
    if (!display.begin(SSD1306_SWITCHCAPVCC, OLED_ADDR))
    {
        Serial.println("[LoRa Receiver] Falha ao inicializar comunicacao com OLED");
    }
    else
    {
        Serial.println("[LoRa Receiver] Comunicacao com OLED inicializada com sucesso");

        /* Limpa display e configura tamanho de fonte */
        display.clearDisplay();
        display.setTextSize(1);
        display.setTextColor(WHITE);
        return false;
    }
}

/* Funcao de setup */
void setup()
{
    Serial.begin(DEBUG_SERIAL_BAUDRATE);
    Wire.begin(OLED_SDA_PIN, OLED_SCL_PIN);

    
    while (!Serial)
        ;

    Serial.println("Aguardando display...");
    
    while (displayInit())
        ;
    display.clearDisplay();    
    display.drawBitmap(0, 10, scania_logo, 128, 64, 1);
    display.display();

    delay(5000);
    display.clearDisplay();

    display.invertDisplay(false);
    Serial.println("Display OK");
    display.setCursor(0, OLED_LINE1);
    display.println("Display: OK");
    display.display();
    
    display.println("Sensor: ...");
    display.display();
        
    if (!lox.begin())
    {
        display.println("Sensor: ERROR");
        display.display();
        Serial.println(F("Failed to boot VL53L0X"));
        while (1)
            ;
    }

    display.println("Sensor: OK");
    display.display();

    /* Tenta, até obter sucesso, comunicacao com o chip LoRa */
    display.println("LoRa: ...");
    display.display();
    
    while (loRaInit() == false)
        ;

    display.println("LoRa: Ok");
    display.display();

    delay(5000);
}

/* Programa principal */
void loop()
{
    VL53L0X_RangingMeasurementData_t measure;
    lox.rangingTest(&measure, false); // pass in 'true' to get debug data printout!

    if (measure.RangeStatus != 4)
    { // phase failures have incorrect data
        info = 100 - (measure.RangeMilliMeter * 100) / tamanho_tanque;
    }

    else
    {
        info = 0;
    }

    //Configura display para mostrar informações

    display.clearDisplay();
    display.setTextSize(1);
    display.setCursor(0, OLED_LINE1);
    display.println("Sensor Data: ");
    display.println("---------------------");
    display.setTextSize(2);
    display.print(info);
    display.println("%");
    display.print(measure.RangeMilliMeter);
    display.println(" mm");
    
    display.display();

    char lora_string[10] = "";
    sprintf(lora_string, "%d", info);

    strcat(lora_string, ",");
    strcat(lora_string, id_sensor);

    if (info != -1)
    {
        /* Envia a informação */
        LoRa.beginPacket();
        LoRa.println(id_sensor);
        LoRa.println(info);
        LoRa.endPacket();
    }

    delay(1000);
}
